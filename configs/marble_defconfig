## configs/marble_defconfig
```kconfig
#
# arch/arm64/configs/marble_defconfig
#
# Aurora-Kernel optimized defconfig for Xiaomi marble
# SoC: SM7475 (diwali die) on SM8450 (waipio/taro) platform base
# Base: Android Common Kernel (ACK) 6.18 LTS  (Google AOSP common-android17-6.18)
#
# ACK already provides Android patches (binderfs/ashmem/GKI/vendor hooks);
# this defconfig only enables device + optimization options on top of GKI.
#
# Build:  make ARCH=arm64 marble_defconfig
# Merge:  ./scripts/config-merge.sh   (pulls in fragments/*)
#

# ---------------------------------------------------------------------------
# Platform / SoC
# ---------------------------------------------------------------------------
CONFIG_ARCH_QCOM=y
CONFIG_ARCH_WAIPIO=y
CONFIG_ARCH_DIWALI=y
CONFIG_ARCH_CAPE=y
CONFIG_ARM64=y
CONFIG_ARM64_4K_PAGES=y
CONFIG_MMU=y
CONFIG_ARCH_ENABLE_MEMORY_HOTPLUG=y
CONFIG_ARCH_ENABLE_SPLIT_PMD_PTLOCK=y

# ---------------------------------------------------------------------------
# Compiler / toolchain
# ---------------------------------------------------------------------------
CONFIG_CC_IS_CLANG=y
CONFIG_LD_IS_LLD=y
CONFIG_CC_VERSION_TEXT="Clang 18"
CONFIG_LD_VERSION=180000
CONFIG_LTO_CLANG=y
CONFIG_LTO_CLANG_THIN=y
CONFIG_CFI_CLANG=y
CONFIG_CFI_PERMISSIVE=n

# ---------------------------------------------------------------------------
# CPU & scheduler (EAS, schedutil, UCLAMP, WALT)
# ---------------------------------------------------------------------------
CONFIG_SMP=y
CONFIG_NR_CPUS=8
CONFIG_SCHED_MC=y
CONFIG_SCHED_SMT=y
CONFIG_SCHED_CLUSTER=y
CONFIG_SCHED_EAS=y
CONFIG_SCHED_WALT=y
CONFIG_SCHED_HMP=y
CONFIG_UCLAMP_TASK=y
CONFIG_UCLAMP_BYPASS_MISMATCH=y
CONFIG_UCLAMP_TASK_GROUP=y
CONFIG_CPU_FREQ=y
CONFIG_CPU_FREQ_GOV_POWERSAVE=y
CONFIG_CPU_FREQ_GOV_USERSPACE=y
CONFIG_CPU_FREQ_GOV_ONDEMAND=y
CONFIG_CPU_FREQ_GOV_SCHEDUTIL=y
CONFIG_CPU_FREQ_DEFAULT_GOV_SCHEDUTIL=y
CONFIG_CPU_FREQ_GOV_INTERACTIVE=y
CONFIG_CPUFREQ_DT=y
CONFIG_CPUFREQ_DT_PLATDEV=y
CONFIG_CPU_IDLE=y
CONFIG_CPU_IDLE_MULTIPLE_DRIVERS=y
CONFIG_CPU_IDLE_GOV_LADDER=y
CONFIG_CPU_IDLE_GOV_MENU=y
CONFIG_CPU_IDLE_GOV_TEO=y
CONFIG_ARM_PSCI=y
CONFIG_ARM_PSCI_FW=y
CONFIG_QCOM_SCM=y

# ---------------------------------------------------------------------------
# Memory / zRAM / swap
# ---------------------------------------------------------------------------
CONFIG_ZRAM=y
CONFIG_ZRAM_WRITEBACK=y
CONFIG_ZRAM_MEMORY_TRACKING=y
CONFIG_ZSMALLOC=y
CONFIG_SWAP=y
CONFIG_ZSWAP=y
CONFIG_ZSWAP_COMPRESSOR_DEFAULT_ZSTD=y
CONFIG_ZSWAP_ZPOOL_DEFAULT_ZSMALLOC=y
CONFIG_ZBUD=y
CONFIG_Z3FOLD=y
CONFIG_ZSMALLOC=y
CONFIG_MEMORY_HOTPLUG=y
CONFIG_TRANSPARENT_HUGEPAGE=y
CONFIG_TRANSPARENT_HUGEPAGE_MADVISE=y
CONFIG_KSM=y
CONFIG_FRONTSWAP=y
CONFIG_CLEANCACHE=n

# ---------------------------------------------------------------------------
# Block / I/O
# ---------------------------------------------------------------------------
CONFIG_BLOCK=y
CONFIG_BLK_DEV=y
CONFIG_BLK_DEV_LOOP=y
CONFIG_BLK_DEV_SD=y
CONFIG_BLK_DEV_INITRD=y
CONFIG_SCSI=y
CONFIG_SCSI_UFSHCD=y
CONFIG_SCSI_UFSHCD_PLATFORM=y
CONFIG_SCSI_UFS_QCOM=y
CONFIG_SCSI_UFS_CRYPTO=y
CONFIG_SCSI_UFS_HPB=y
CONFIG_SCSI_UFS_HWMON=y
CONFIG_MMC=y
CONFIG_MMC_SDHCI=y
CONFIG_MMC_SDHCI_PLTFM=y
CONFIG_MMC_SDHCI_MSM=y

# I/O scheduler — flash-friendly
CONFIG_MQ_IOSCHED_DEADLINE=y
CONFIG_MQ_IOSCHED_KYBER=y
CONFIG_IOSCHED_BFQ=y
CONFIG_BFQ_GROUP_IOSCHED=y

# ---------------------------------------------------------------------------
# Filesystems
# ---------------------------------------------------------------------------
CONFIG_EXT4_FS=y
CONFIG_EXT4_FS_POSIX_ACL=y
CONFIG_EXT4_FS_SECURITY=y
CONFIG_EXT4_ENCRYPTION=y
CONFIG_F2FS_FS=y
CONFIG_F2FS_FS_SECURITY=y
CONFIG_F2FS_FS_ENCRYPTION=y
CONFIG_F2FS_FS_COMPRESSION=y
CONFIG_F2FS_STAT_FS=y
CONFIG_FS_ENCRYPTION=y
CONFIG_FS_ENCRYPTION_INLINE_CRYPT=y
CONFIG_FS_VERITY=y
CONFIG_FSCRYPT=y
CONFIG_FSCRYPT_ADVANCED_HMAC=y
CONFIG_QUOTA=y
CONFIG_QUOTACTL=y
CONFIG_AUTOFS_FS=y
CONFIG_FAT_FS=y
CONFIG_VFAT_FS=y
CONFIG_EXFAT_FS=y
CONFIG_NTFS3_FS=y
CONFIG_NTFS3_LZX_XPRESS=y
CONFIG_NTFS3_FS_POSIX_ACL=y
CONFIG_TMPFS=y
CONFIG_TMPFS_POSIX_ACL=y
CONFIG_TMPFS_XATTR=y
CONFIG_PROC_FS=y
CONFIG_PROC_SYSCTL=y
CONFIG_SYSFS=y
CONFIG_DEBUG_FS=y
CONFIG_CONFIGFS_FS=y
CONFIG_PSTORE=y
CONFIG_PSTORE_RAM=y
CONFIG_PSTORE_CONSOLE=y
CONFIG_PSTORE_PMSG=y

# ---------------------------------------------------------------------------
# Networking
# ---------------------------------------------------------------------------
CONFIG_NET=y
CONFIG_PACKET=y
CONFIG_UNIX=y
CONFIG_INET=y
CONFIG_IP_MULTICAST=y
CONFIG_IP_ADVANCED_ROUTER=y
CONFIG_IP_MULTIPLE_TABLES=y
CONFIG_IP_PNP=y
CONFIG_IP_PNP_DHCP=y
CONFIG_SYN_COOKIES=y
CONFIG_NETFILTER=y
CONFIG_NETFILTER_ADVANCED=y
CONFIG_NETFILTER_XTABLES=y
CONFIG_NETFILTER_XT_TARGET_MASQUERADE=y
CONFIG_NETFILTER_XT_TARGET_MARK=y
CONFIG_NETFILTER_XT_MATCH_COMMENT=y
CONFIG_NETFILTER_XT_MATCH_CONNTRACK=y
CONFIG_NETFILTER_XT_MATCH_STATE=y
CONFIG_NF_CONNTRACK=y
CONFIG_NF_TABLES=y
CONFIG_NF_TABLES_INET=y
CONFIG_NFT_CT=y
CONFIG_NFT_MASQ=y
CONFIG_NFT_COMPAT=y
CONFIG_NETFILTER_XT_MATCH_BPF=y
CONFIG_NET_ACT_BPF=y
CONFIG_NET_SCH_FQ_CODEL=y
CONFIG_NET_SCH_FQ=y
CONFIG_NET_SCH_CAKE=y
CONFIG_NET_EMATCH=y
CONFIG_NET_CLS_ACT=y

# Wireless
CONFIG_CFG80211=y
CONFIG_CFG80211_WEXT=y
CONFIG_MAC80211=y
CONFIG_WIRELESS=y
CONFIG_RFKILL=y

# WireGuard (in-kernel)
CONFIG_WIREGUARD=y

# USB networking
CONFIG_USB_NET_DRIVERS=y
CONFIG_USB_USBNET=y
CONFIG_USB_NET_CDCETHER=y
CONFIG_USB_NET_RNDIS_HOST=y
CONFIG_USB_NET_CDC_NCM=y
CONFIG_USB_NET_AX88179_178A=y

# Bluetooth
CONFIG_BT=y
CONFIG_BT_BREDR=y
CONFIG_BT_LE=y
CONFIG_BT_HCIVHCI=y
CONFIG_BT_HCIBTUSB=m

# ---------------------------------------------------------------------------
# DMA / IOMMU / IRQ
# ---------------------------------------------------------------------------
CONFIG_QCOM_BAM_DMA=y
CONFIG_DMADEVICES=y
CONFIG_IOMMU_API=y
CONFIG_IOMMU_SUPPORT=y
CONFIG_IOMMU_IO_PGTABLE_ARMV7S=y
CONFIG_IOMMU_IO_PGTABLE_LPAE=y
CONFIG_ARM_SMMU=y
CONFIG_ARM_SMMU_V3=y
CONFIG_QCOM_IOMMU=y
CONFIG_IRQ_DOMAIN_HIERARCHY=y
CONFIG_QCOM_PDC=y
CONFIG_QCOM_MPM=y

# ---------------------------------------------------------------------------
# Clocks / Reset / Pinctrl (Qualcomm)
# ---------------------------------------------------------------------------
CONFIG_COMMON_CLK=y
CONFIG_COMMON_CLK_QCOM=y
CONFIG_QCOM_GDSC=y
CONFIG_QCOM_RPMH=y
CONFIG_QCOM_RPMHPD=y
CONFIG_QCOM_RPMPD=y
CONFIG_PINCTRL=y
CONFIG_PINCTRL_MSM=y
CONFIG_PINCTRL_SM8450=y
CONFIG_PINCTRL_WAIPIO=y
CONFIG_PINCTRL_DIWALI=y
CONFIG_PINCTRL_CAPE=y
CONFIG_QCOM_AOSS_QMP=y
CONFIG_QCOM_SMEM=y
CONFIG_QCOM_SMP2P=y
CONFIG_QCOM_STATS=y
CONFIG_QCOM_DUMP=y

# ---------------------------------------------------------------------------
# Regulators / ADC / Thermal
# ---------------------------------------------------------------------------
CONFIG_REGULATOR=y
CONFIG_REGULATOR_FIXED_VOLTAGE=y
CONFIG_REGULATOR_QCOM_RPMH=y
CONFIG_REGULATOR_QCOM_SPMI=y
CONFIG_REGULATOR_RPMH=y
CONFIG_THERMAL=y
CONFIG_THERMAL_EMERGENCY_POWEROFF_DELAY_MS=0
CONFIG_THERMAL_HWMON=y
CONFIG_THERMAL_OF=y
CONFIG_THERMAL_WRITABLE_TRIPS=y
CONFIG_THERMAL_DEFAULT_GOV_STEP_WISE=y
CONFIG_THERMAL_GOV_USER_SPACE=y
CONFIG_THERMAL_GOV_POWER_ALLOCATOR=y
CONFIG_CPU_THERMAL=y
CONFIG_QCOM_TSENS=y
CONFIG_QCOM_SPMI_TEMP_ALARM=y
CONFIG_WATCHDOG=y
CONFIG_QCOM_WDT=y

# ---------------------------------------------------------------------------
# Display / GPU / DRM
# ---------------------------------------------------------------------------
CONFIG_DRM=y
CONFIG_DRM_MSM=y
CONFIG_DRM_PANEL=y
CONFIG_DRM_PANEL_SIMPLE=y
CONFIG_FB=y
CONFIG_FB_ARMCLCD=y
CONFIG_BACKLIGHT_CLASS_DEVICE=y
CONFIG_GPU_PWRDCOLLECTOR=y
CONFIG_MSM_ADRENO=y
CONFIG_QCOM_KGSL=y
CONFIG_QCOM_KGSL_*y

# ---------------------------------------------------------------------------
# Audio / Sound
# ---------------------------------------------------------------------------
CONFIG_SOUND=y
CONFIG_SND=y
CONFIG_SND_SOC=y
CONFIG_SND_SOC_QCOM=y
CONFIG_SND_SOC_MSM8996=y
CONFIG_SND_SOC_QDSP6=y
CONFIG_SND_SOC_QCOM_INTERNAL=y
CONFIG_SND_SIMPLE_CARD=y
CONFIG_SND_HRTIMER=y
CONFIG_SND_PCM_TIMER=y

# ---------------------------------------------------------------------------
# USB
# ---------------------------------------------------------------------------
CONFIG_USB=y
CONFIG_USB_SUPPORT=y
CONFIG_USB_GADGET=y
CONFIG_USB_DWC3=y
CONFIG_USB_DWC3_MSM=y
CONFIG_USB_DWC3_DUAL_ROLE=y
CONFIG_USB_CONFIGFS=y
CONFIG_USB_CONFIGFS_F_ADB=y
CONFIG_USB_CONFIGFS_F_FS=y
CONFIG_USB_CONFIGFS_F_MTP=y
CONFIG_USB_CONFIGFS_F_PTP=y
CONFIG_USB_CONFIGFS_F_ACC=y
CONFIG_USB_CONFIGFS_F_DIAG=y
CONFIG_USB_CONFIGFS_F_RNDIS=y
CONFIG_USB_CONFIGFS_F_SERIAL=y
CONFIG_USB_F_DSI=y
CONFIG_USB_F_FDL=y
CONFIG_USB_F_NCM=y
CONFIG_USB_F_ECM=y
CONFIG_USB_F_MASS_STORAGE=y
CONFIG_USB_GADGETFS=y

# ---------------------------------------------------------------------------
# Android / Binder / Ashmem / IPC
# ---------------------------------------------------------------------------
CONFIG_ANDROID=y
CONFIG_ANDROID_BINDER_IPC=y
CONFIG_ANDROID_BINDERFS=y
CONFIG_ANDROID_BINDER_DEVICES="binder,hwbinder,vndbinder"
CONFIG_ASHMEM=y
CONFIG_ANDROID_LOGGER=n
CONFIG_FIQ_DEBUGGER=n
CONFIG_ANDROID_RAM_CONSOLE=n
CONFIG_TIMA=n
CONFIG_ARCH_HAS_DEVMEM_IS_ALLOWED=y

# ---------------------------------------------------------------------------
# Security
# ---------------------------------------------------------------------------
CONFIG_SECURITY=y
CONFIG_SECURITYFS=y
CONFIG_SECURITY_SELINUX=y
CONFIG_SECURITY_SELINUX_BOOTPARAM=y
CONFIG_SECURITY_SELINUX_DISABLE=y
CONFIG_SECURITY_SELINUX_DEVELOP=y
CONFIG_SECURITY_SELINUX_BOOTPARAM_VALUE=1
CONFIG_SECURITY_SELINUX_CHECKREQPROT_VALUE=0
CONFIG_SECURITY_SELINUX_SIDTAB_HASH_BITS=8
CONFIG_SECURITY_NETWORK=y
CONFIG_SECURITY_YAMA=y
CONFIG_SECURITY_LANDLOCK=y
CONFIG_HARDENED_USERCOPY=y
CONFIG_FORTIFY_SOURCE=y
CONFIG_SLAB_FREELIST_RANDOM=y
CONFIG_SLAB_FREELIST_HARDENED=y
CONFIG_RANDOMIZE_BASE=y
CONFIG_RANDOMIZE_MODULE_REGION_FULL=y
CONFIG_CC_STACKPROTECTOR_STRONG=y
CONFIG_REFCOUNT_FULL=y
CONFIG_ARM64_SW_TTBR0_PAN=y
CONFIG_UNMAP_KERNEL_AT_EL0=y
CONFIG_HARDEN_BRANCH_PREDICTOR=y
CONFIG_RODATA_FULL_DEFAULT_ENABLED=y
CONFIG_ARM64_PTR_AUTH=y
CONFIG_ARM64_PTR_AUTH_KERNEL=y
CONFIG_ARM64_BTI_KERNEL=y
CONFIG_ARM64_MTE=y
CONFIG_ARM64_E0PD=y
CONFIG_ARM64_SW_E0PD=y

# ---------------------------------------------------------------------------
# Crypto
# ---------------------------------------------------------------------------
CONFIG_CRYPTO=y
CONFIG_CRYPTO_HW=y
CONFIG_CRYPTO_USER_API=y
CONFIG_CRYPTO_USER_API_HASH=y
CONFIG_CRYPTO_USER_API_SKCIPHER=y
CONFIG_CRYPTO_AEAD=y
CONFIG_CRYPTO_GCM=y
CONFIG_CRYPTO_CHACHA20=y
CONFIG_CRYPTO_POLY1305=y
CONFIG_CRYPTO_XCBC=y
CONFIG_CRYPTO_SHA256=y
CONFIG_CRYPTO_SHA512=y
CONFIG_CRYPTO_AKCIPHER2=y
CONFIG_CRYPTO_RSA=y
CONFIG_CRYPTO_DH=y
CONFIG_CRYPTO_ECDH=y
CONFIG_CRYPTO_AES=y
CONFIG_CRYPTO_AES_ARM64=y
CONFIG_CRYPTO_AES_ARM64_CE_BLK=y
CONFIG_CRYPTO_AES_ARM64_CE_CCM=y
CONFIG_CRYPTO_GHASH_ARM64_CE=y
CONFIG_CRYPTO_CRCT10DIF=y
CONFIG_CRYPTO_CRC32C=y
CONFIG_CRYPTO_ZSTD=y
CONFIG_CRYPTO_LZ4=y
CONFIG_CRYPTO_LZO=y
CONFIG_CRYPTO_DEV_QCOM=y
CONFIG_CRYPTO_DEV_QCOM_MSM=y
CONFIG_CRYPTO_DEV_QCOM_ICE=y
CONFIG_CRYPTO_ADIANTUM=y
CONFIG_CRYPTO_NHPoly1305=y
CONFIG_CRYPTO_LIB_CHACHA20_POLY1305=y
CONFIG_BLK_CRYPTO=y
CONFIG_BLK_CRYPTO_FALLOW=y
CONFIG_FS_CRYPTO=y

# ---------------------------------------------------------------------------
# KernelSU-Next (root)
# ---------------------------------------------------------------------------
CONFIG_KSU=y
CONFIG_KSU_DEBUG=n
CONFIG_KSU_SUSFS=y
CONFIG_KSU_KPROBES=y
CONFIG_KPROBES=y
CONFIG_KPROBE_EVENTS=y
CONFIG_HAVE_KPROBES=y
CONFIG_KRETPROBES=y
CONFIG_KPROBES_ON_FTRACE=y
CONFIG_MODULES=y
CONFIG_MODULE_UNLOAD=y
CONFIG_MODULE_SIG=n
CONFIG_MODULE_COMPRESS_XZ=y
CONFIG_MODVERSIONS=y
CONFIG_MODULE_DECOMPRESS=y

# ---------------------------------------------------------------------------
# Tracing / BPF / observability
# ---------------------------------------------------------------------------
CONFIG_FTRACE=y
CONFIG_FUNCTION_TRACER=y
CONFIG_FUNCTION_GRAPH_TRACER=y
CONFIG_TRACEPOINTS=y
CONFIG_TRACING=y
CONFIG_IRQSOFF_TRACER=n
CONFIG_SCHED_TRACER=n
CONFIG_FTRACE_SYSCALLS=y
CONFIG_BPF=y
CONFIG_BPF_SYSCALL=y
CONFIG_BPF_JIT=y
CONFIG_BPF_JIT_ALWAYS_ON=y
CONFIG_BPF_TRAMPOLINE=y
CONFIG_HAVE_EBPF_JIT=y
CONFIG_BPF_EVENTS=y
CONFIG_BPF_KPROBE_OVERRIDE=y
CONFIG_KPROBE_EVENTS=y
CONFIG_UPROBE_EVENTS=y
CONFIG_HIST_TRIGGERS=y
CONFIG_DEBUG_BTF=y
CONFIG_DEBUG_INFO_BTF=y
CONFIG_DEBUG_INFO_BTF_MODULES=y
CONFIG_DEBUG_INFO_DWARF5=n
CONFIG_PAHOLE_HAS_SPLIT_BTF=y
CONFIG_PAHOLE_HAS_BTF_TAG=y
CONFIG_CONFIGFS_FS=y

# ---------------------------------------------------------------------------
# eBPF / perf
# ---------------------------------------------------------------------------
CONFIG_PERF_EVENTS=y
CONFIG_HW_PERF_EVENTS=y
CONFIG_ARM_PMU=y
CONFIG_ARM_PMUV3=y
CONFIG_ARM_DSU_PMU=y
CONFIG_QCOM_L3_PMU=y
CONFIG_ARM_CORESIGHT_PMU_ARCH_SYSTEM_PMU=y

# ---------------------------------------------------------------------------
# Virtualization: KVM
# ---------------------------------------------------------------------------
CONFIG_VIRTUALIZATION=y
CONFIG_KVM=y
CONFIG_KVM_ARM_HOST=y
CONFIG_KVM_ARM_PMU=y
CONFIG_VHOST_NET=y
CONFIG_VHOST_VSOCK=y

# ---------------------------------------------------------------------------
# Power management / battery
# ---------------------------------------------------------------------------
CONFIG_PM=y
CONFIG_PM_SLEEP=y
CONFIG_PM_SLEEP_SMP=y
CONFIG_PM_WAKELOCKS=y
CONFIG_PM_WAKELOCKS_LIMIT=0
CONFIG_PM_AUTOSLEEP=n
CONFIG_PM_RUNTIME=y
CONFIG_PM_ADVANCED_DEBUG=y
CONFIG_PM_CLK=y
CONFIG_PM_GENERIC_DOMAINS=y
CONFIG_PM_GENERIC_DOMAINS_OF=y
CONFIG_PM_GENERIC_DOMAINS_SLEEP=y
CONFIG_POWERCAP=y
CONFIG_POWER_RESET=y
CONFIG_POWER_RESET_QCOM=y
CONFIG_POWER_SUPPLY=y
CONFIG_BATTERY=y
CONFIG_BATTERY_BQ27XXX=y
CONFIG_CHARGER=y
CONFIG_QCOM_PM=y
CONFIG_QCOM_GLINK_SSR=y
CONFIG_QCOM_RMTFS_MEM=y
CONFIG_QCOM_PIL_INFO=y
CONFIG_QCOM_FASTRTP=y

# ---------------------------------------------------------------------------
# Input / sensors / LEDs / vibrators
# ---------------------------------------------------------------------------
CONFIG_INPUT=y
CONFIG_INPUT_EVDEV=y
CONFIG_INPUT_TOUCHSCREEN=y
CONFIG_TOUCHSCREEN_FTS=y
CONFIG_INPUT_MISC=y
CONFIG_INPUT_UINPUT=y
CONFIG_SENSORS=y
CONFIG_IIO=y
CONFIG_QCOM_SPMI_VADC=y
CONFIG_QCOM_SPMI_ADC5=y
CONFIG_QCOM_VADC_COMMON=y
CONFIG_LEDS_CLASS=y
CONFIG_LEDS_CLASS_FLASH=y
CONFIG_LEDS_TRIGGER_TIMER=y
CONFIG_LEDS_TRIGGER_PATTERN=y
CONFIG_QCOM_SPMI_FLASH_LED=y
CONFIG_QPNP_LED=y
CONFIG_QPNP_PWM=y
CONFIG_INPUT_GPIO=y
CONFIG_QCOM_SPMI_HAPTICS=y

# ---------------------------------------------------------------------------
# RTC / timers / clocks
# ---------------------------------------------------------------------------
CONFIG_RTC_CLASS=y
CONFIG_RTC_DRV_PM8xxx=y
CONFIG_QCOM_HIDMA=y
CONFIG_QCOM_HIDMA_MGMT=y
CONFIG_ARM_ARCH_TIMER=y
CONFIG_ARM_TIMER_SP804=y
CONFIG_HIGH_RES_TIMERS=y
CONFIG_TICK_ONESHOT=y
CONFIG_NO_HZ=y
CONFIG_NO_HZ_COMMON=y
CONFIG_NO_HZ_IDLE=y
CONFIG_NO_HZ_FULL=n
CONFIG_HIGH_RES_TIMERS=y
CONFIG_POSIX_TIMERS=y

# ---------------------------------------------------------------------------
# Misc drivers / debugging
# ---------------------------------------------------------------------------
CONFIG_HWSPINLOCK=y
CONFIG_HWSPINLOCK_QCOM=y
CONFIG_QCOM_SMEM_STATE=y
CONFIG_QCOM_SMP2P=y
CONFIG_QCOM_STATS=y
CONFIG_QCOM_AOPSSD=y
CONFIG_QCOM_IPCC=y
CONFIG_QCOM_ICP=y
CONFIG_MSM_CORELLC_HELPER=y
CONFIG_PRINTK=y
CONFIG_PRINTK_TIME=y
CONFIG_DYNAMIC_DEBUG=y
CONFIG_MAGIC_SYSRQ=y
CONFIG_DEBUG_KERNEL=y
CONFIG_PANIC_ON_OOPS=y
CONFIG_PANIC_TIMEOUT=5
CONFIG_BUG=y
CONFIG_BUG_ON_DATA_CORRUPTION=y
CONFIG_SCHED_DEBUG=n
CONFIG_DEBUG_PREEMPT=n
CONFIG_LOCKUP_DETECTOR=y
CONFIG_SOFTLOCKUP_DETECTOR=y
CONFIG_HARDLOCKUP_DETECTOR=y
CONFIG_DETECT_HUNG_TASK=y
CONFIG_DEFAULT_HUNG_TASK_TIMEOUT=120
CONFIG_WQ_WATCHDOG=y

# ---------------------------------------------------------------------------
# End
# ---------------------------------------------------------------------------
```
